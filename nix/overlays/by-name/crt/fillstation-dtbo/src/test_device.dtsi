/* This file was auto-generated by TI PinMux on 9/26/2026 at 2:30:47 PM. */
/* This file should only be used as a reference. Some pins/peripherals, */
/* depending on your use case, may need additional configuration. */

&main_pmx0 {
	ti_peripherals_gpio0_pins_default: ti_peripherals_gpio0-default-pins {
		pinctrl-single,pins = <
			AM64X_IOPAD(0x0000, PIN_DEBOUNCE_DISABLE|PIN_INPUT|PIN_DRIVE_STRENGTH_NOMINAL|PIN_SCMITT_TRIGGER_ENABLE, 7) /* (N20) OSPI0_CLK.GPIO0_0 ti_peripherals_GPIOpin0 */
		>;
	};
	mygpio01_notconf_pins_default: mygpio01_notconf-default-pins {
		pinctrl-single,pins = <
			AM64X_IOPAD(0x0004, PIN_DEBOUNCE_DISABLE|PIN_INPUT|PIN_DRIVE_STRENGTH_NOMINAL|PIN_SCMITT_TRIGGER_ENABLE, 7) /* (N21) OSPI0_LBCLKO.GPIO0_1 Pin not configured */
		>;
	};
	mygpio02_notconf_pins_default: mygpio02_notconf-default-pins {
		pinctrl-single,pins = <
			AM64X_IOPAD(0x0008, PIN_DEBOUNCE_DISABLE|PIN_OUTPUT|PIN_DRIVE_STRENGTH_NOMINAL|PIN_SCMITT_TRIGGER_ENABLE, 7) /* (N19) OSPI0_DQS.GPIO0_2 Pin not configured */
		>;
	};
	mygpio03_notconf_pins_default: mygpio03_notconf-default-pins {
		pinctrl-single,pins = <
			AM64X_IOPAD(0x000c, PIN_DEBOUNCE_DISABLE|PIN_OUTPUT|PIN_DRIVE_STRENGTH_NOMINAL|PIN_SCMITT_TRIGGER_ENABLE, 7) /* (M19) OSPI0_D0.GPIO0_3 Pin not configured */
		>;
	};
	mygpio04_notconf_pins_default: mygpio04_notconf-default-pins {
		pinctrl-single,pins = <
			AM64X_IOPAD(0x0010, PIN_DEBOUNCE_DISABLE|PIN_OUTPUT|PIN_DRIVE_STRENGTH_NOMINAL|PIN_SCMITT_TRIGGER_ENABLE, 7) /* (M18) OSPI0_D1.GPIO0_4 Pin not configured */
		>;
	};
	mygpio05_notconf_pins_default: mygpio05_notconf-default-pins {
		pinctrl-single,pins = <
			AM64X_IOPAD(0x0014, PIN_DEBOUNCE_DISABLE|PIN_OUTPUT|PIN_DRIVE_STRENGTH_NOMINAL|PIN_SCMITT_TRIGGER_ENABLE, 7) /* (M20) OSPI0_D2.GPIO0_5 Pin not configured */
		>;
	};
	mygpio06_notconf_pins_default: mygpio06_notconf-default-pins {
		pinctrl-single,pins = <
			AM64X_IOPAD(0x0018, PIN_DEBOUNCE_DISABLE|PIN_OUTPUT|PIN_DRIVE_STRENGTH_NOMINAL|PIN_SCMITT_TRIGGER_ENABLE, 7) /* (M21) OSPI0_D3.GPIO0_6 Pin not configured */
		>;
	};
	mygpio07_notconf_pins_default: mygpio07_notconf-default-pins {
		pinctrl-single,pins = <
			AM64X_IOPAD(0x001c, PIN_DEBOUNCE_DISABLE|PIN_OUTPUT|PIN_DRIVE_STRENGTH_NOMINAL|PIN_SCMITT_TRIGGER_ENABLE, 7) /* (P21) OSPI0_D4.GPIO0_7 Pin not configured */
		>;
	};
	mygpio08_notconf_pins_default: mygpio08_notconf-default-pins {
		pinctrl-single,pins = <
			AM64X_IOPAD(0x0020, PIN_DEBOUNCE_DISABLE|PIN_OUTPUT|PIN_DRIVE_STRENGTH_NOMINAL|PIN_SCMITT_TRIGGER_ENABLE, 7) /* (P20) OSPI0_D5.GPIO0_8 Pin not configured */
		>;
	};
	mygpio09_notconf_pins_default: mygpio09_notconf-default-pins {
		pinctrl-single,pins = <
			AM64X_IOPAD(0x0024, PIN_DEBOUNCE_DISABLE|PIN_OUTPUT|PIN_DRIVE_STRENGTH_NOMINAL|PIN_SCMITT_TRIGGER_ENABLE, 7) /* (N18) OSPI0_D6.GPIO0_9 Pin not configured */
		>;
	};
	mygpio010_notconf_pins_default: mygpio010_notconf-default-pins {
		pinctrl-single,pins = <
			AM64X_IOPAD(0x0028, PIN_DEBOUNCE_DISABLE|PIN_OUTPUT|PIN_DRIVE_STRENGTH_NOMINAL|PIN_SCMITT_TRIGGER_ENABLE, 7) /* (M17) OSPI0_D7.GPIO0_10 Pin not configured */
		>;
	};
	mygpio011_notconf_pins_default: mygpio011_notconf-default-pins {
		pinctrl-single,pins = <
			AM64X_IOPAD(0x002c, PIN_DEBOUNCE_DISABLE|PIN_OUTPUT|PIN_DRIVE_STRENGTH_NOMINAL|PIN_SCMITT_TRIGGER_ENABLE, 7) /* (L19) OSPI0_CSn0.GPIO0_11 Pin not configured */
		>;
	};
	mygpio012_notconf_pins_default: mygpio012_notconf-default-pins {
		pinctrl-single,pins = <
			AM64X_IOPAD(0x0030, PIN_DEBOUNCE_DISABLE|PIN_OUTPUT|PIN_DRIVE_STRENGTH_NOMINAL|PIN_SCMITT_TRIGGER_ENABLE, 7) /* (L18) OSPI0_CSn1.GPIO0_12 Pin not configured */
		>;
	};
	mygpio013_notconf_pins_default: mygpio013_notconf-default-pins {
		pinctrl-single,pins = <
			AM64X_IOPAD(0x0034, PIN_DEBOUNCE_DISABLE|PIN_OUTPUT|PIN_DRIVE_STRENGTH_NOMINAL|PIN_SCMITT_TRIGGER_ENABLE, 7) /* (K17) OSPI0_CSn2.GPIO0_13 Pin not configured */
		>;
	};
	mygpio014_notconf_pins_default: mygpio014_notconf-default-pins {
		pinctrl-single,pins = <
			AM64X_IOPAD(0x0038, PIN_DEBOUNCE_DISABLE|PIN_OUTPUT|PIN_DRIVE_STRENGTH_NOMINAL|PIN_SCMITT_TRIGGER_ENABLE, 7) /* (L17) OSPI0_CSn3.GPIO0_14 Pin not configured */
		>;
	};
	mygpio015_notconf_pins_default: mygpio015_notconf-default-pins {
		pinctrl-single,pins = <
			AM64X_IOPAD(0x003c, PIN_DEBOUNCE_DISABLE|PIN_INPUT|PIN_DRIVE_STRENGTH_NOMINAL|PIN_SCMITT_TRIGGER_ENABLE, 7) /* (T20) GPMC0_AD0.GPIO0_15 Pin not configured */
		>;
	};
	mygpio016_notconf_pins_default: mygpio016_notconf-default-pins {
		pinctrl-single,pins = <
			AM64X_IOPAD(0x0040, PIN_DEBOUNCE_DISABLE|PIN_INPUT|PIN_DRIVE_STRENGTH_NOMINAL|PIN_SCMITT_TRIGGER_ENABLE, 7) /* (U21) GPMC0_AD1.GPIO0_16 Pin not configured */
		>;
	};
	mygpio017_notconf_pins_default: mygpio017_notconf-default-pins {
		pinctrl-single,pins = <
			AM64X_IOPAD(0x0044, PIN_DEBOUNCE_DISABLE|PIN_INPUT|PIN_DRIVE_STRENGTH_NOMINAL|PIN_SCMITT_TRIGGER_ENABLE, 7) /* (T18) GPMC0_AD2.GPIO0_17 Pin not configured */
		>;
	};
	mygpio018_notconf_pins_default: mygpio018_notconf-default-pins {
		pinctrl-single,pins = <
			AM64X_IOPAD(0x0048, PIN_DEBOUNCE_DISABLE|PIN_INPUT|PIN_DRIVE_STRENGTH_NOMINAL|PIN_SCMITT_TRIGGER_ENABLE, 7) /* (U20) GPMC0_AD3.GPIO0_18 Pin not configured */
		>;
	};
	mygpio082_notconf_pins_default: mygpio082_notconf-default-pins {
		pinctrl-single,pins = <
			AM64X_IOPAD(0x004c, PIN_DEBOUNCE_DISABLE|PIN_INPUT|PIN_DRIVE_STRENGTH_NOMINAL|PIN_SCMITT_TRIGGER_ENABLE, 7) /* (U18) GPMC0_AD4.GPIO0_82 Pin not configured */
		>;
	};
	mygpio083_notconf_pins_default: mygpio083_notconf-default-pins {
		pinctrl-single,pins = <
			AM64X_IOPAD(0x0050, PIN_DEBOUNCE_DISABLE|PIN_INPUT|PIN_DRIVE_STRENGTH_NOMINAL|PIN_SCMITT_TRIGGER_ENABLE, 7) /* (U19) GPMC0_AD5.GPIO0_83 Pin not configured */
		>;
	};
	mygpio021_notconf_pins_default: mygpio021_notconf-default-pins {
		pinctrl-single,pins = <
			AM64X_IOPAD(0x0054, PIN_DEBOUNCE_DISABLE|PIN_INPUT|PIN_DRIVE_STRENGTH_NOMINAL|PIN_SCMITT_TRIGGER_ENABLE, 7) /* (V20) GPMC0_AD6.GPIO0_21 Pin not configured */
		>;
	};
	mygpio022_notconf_pins_default: mygpio022_notconf-default-pins {
		pinctrl-single,pins = <
			AM64X_IOPAD(0x0058, PIN_DEBOUNCE_DISABLE|PIN_INPUT|PIN_DRIVE_STRENGTH_NOMINAL|PIN_SCMITT_TRIGGER_ENABLE, 7) /* (V21) GPMC0_AD7.GPIO0_22 Pin not configured */
		>;
	};
	mygpio023_notconf_pins_default: mygpio023_notconf-default-pins {
		pinctrl-single,pins = <
			AM64X_IOPAD(0x005c, PIN_DEBOUNCE_DISABLE|PIN_INPUT|PIN_DRIVE_STRENGTH_NOMINAL|PIN_SCMITT_TRIGGER_ENABLE, 7) /* (V19) GPMC0_AD8.GPIO0_23 Pin not configured */
		>;
	};
	mygpio024_notconf_pins_default: mygpio024_notconf-default-pins {
		pinctrl-single,pins = <
			AM64X_IOPAD(0x0060, PIN_DEBOUNCE_DISABLE|PIN_INPUT|PIN_DRIVE_STRENGTH_NOMINAL|PIN_SCMITT_TRIGGER_ENABLE, 7) /* (T17) GPMC0_AD9.GPIO0_24 Pin not configured */
		>;
	};
	mygpio025_notconf_pins_default: mygpio025_notconf-default-pins {
		pinctrl-single,pins = <
			AM64X_IOPAD(0x0064, PIN_DEBOUNCE_DISABLE|PIN_INPUT|PIN_DRIVE_STRENGTH_NOMINAL|PIN_SCMITT_TRIGGER_ENABLE, 7) /* (R16) GPMC0_AD10.GPIO0_25 Pin not configured */
		>;
	};
	mygpio026_notconf_pins_default: mygpio026_notconf-default-pins {
		pinctrl-single,pins = <
			AM64X_IOPAD(0x0068, PIN_DEBOUNCE_DISABLE|PIN_INPUT|PIN_DRIVE_STRENGTH_NOMINAL|PIN_SCMITT_TRIGGER_ENABLE, 7) /* (W20) GPMC0_AD11.GPIO0_26 Pin not configured */
		>;
	};
	mygpio027_notconf_pins_default: mygpio027_notconf-default-pins {
		pinctrl-single,pins = <
			AM64X_IOPAD(0x006c, PIN_DEBOUNCE_DISABLE|PIN_INPUT|PIN_DRIVE_STRENGTH_NOMINAL|PIN_SCMITT_TRIGGER_ENABLE, 7) /* (W21) GPMC0_AD12.GPIO0_27 Pin not configured */
		>;
	};
	mygpio028_notconf_pins_default: mygpio028_notconf-default-pins {
		pinctrl-single,pins = <
			AM64X_IOPAD(0x0070, PIN_DEBOUNCE_DISABLE|PIN_INPUT|PIN_DRIVE_STRENGTH_NOMINAL|PIN_SCMITT_TRIGGER_ENABLE, 7) /* (V18) GPMC0_AD13.GPIO0_28 Pin not configured */
		>;
	};
	mygpio029_notconf_pins_default: mygpio029_notconf-default-pins {
		pinctrl-single,pins = <
			AM64X_IOPAD(0x0074, PIN_DEBOUNCE_DISABLE|PIN_INPUT|PIN_DRIVE_STRENGTH_NOMINAL|PIN_SCMITT_TRIGGER_ENABLE, 7) /* (Y21) GPMC0_AD14.GPIO0_29 Pin not configured */
		>;
	};
	mygpio030_notconf_pins_default: mygpio030_notconf-default-pins {
		pinctrl-single,pins = <
			AM64X_IOPAD(0x0078, PIN_DEBOUNCE_DISABLE|PIN_INPUT|PIN_DRIVE_STRENGTH_NOMINAL|PIN_SCMITT_TRIGGER_ENABLE, 7) /* (Y20) GPMC0_AD15.GPIO0_30 Pin not configured */
		>;
	};
	mygpio031_notconf_pins_default: mygpio031_notconf-default-pins {
		pinctrl-single,pins = <
			AM64X_IOPAD(0x007c, PIN_DEBOUNCE_DISABLE|PIN_OUTPUT|PIN_DRIVE_STRENGTH_NOMINAL|PIN_SCMITT_TRIGGER_ENABLE, 7) /* (R17) GPMC0_CLK.GPIO0_31 Pin not configured */
		>;
	};
	mygpio032_notconf_pins_default: mygpio032_notconf-default-pins {
		pinctrl-single,pins = <
			AM64X_IOPAD(0x0084, PIN_DEBOUNCE_DISABLE|PIN_OUTPUT|PIN_DRIVE_STRENGTH_NOMINAL|PIN_SCMITT_TRIGGER_ENABLE, 7) /* (P16) GPMC0_ADVn_ALE.GPIO0_32 Pin not configured */
		>;
	};
	mygpio033_notconf_pins_default: mygpio033_notconf-default-pins {
		pinctrl-single,pins = <
			AM64X_IOPAD(0x0088, PIN_DEBOUNCE_DISABLE|PIN_OUTPUT|PIN_DRIVE_STRENGTH_NOMINAL|PIN_SCMITT_TRIGGER_ENABLE, 7) /* (R18) GPMC0_OEn_REn.GPIO0_33 Pin not configured */
		>;
	};
	mygpio034_notconf_pins_default: mygpio034_notconf-default-pins {
		pinctrl-single,pins = <
			AM64X_IOPAD(0x008c, PIN_DEBOUNCE_DISABLE|PIN_OUTPUT|PIN_DRIVE_STRENGTH_NOMINAL|PIN_SCMITT_TRIGGER_ENABLE, 7) /* (T21) GPMC0_WEn.GPIO0_34 Pin not configured */
		>;
	};
	mygpio035_notconf_pins_default: mygpio035_notconf-default-pins {
		pinctrl-single,pins = <
			AM64X_IOPAD(0x0090, PIN_DEBOUNCE_DISABLE|PIN_OUTPUT|PIN_DRIVE_STRENGTH_NOMINAL|PIN_SCMITT_TRIGGER_ENABLE, 7) /* (P17) GPMC0_BE0n_CLE.GPIO0_35 Pin not configured */
		>;
	};
	mygpio036_notconf_pins_default: mygpio036_notconf-default-pins {
		pinctrl-single,pins = <
			AM64X_IOPAD(0x0094, PIN_DEBOUNCE_DISABLE|PIN_OUTPUT|PIN_DRIVE_STRENGTH_NOMINAL|PIN_SCMITT_TRIGGER_ENABLE, 7) /* (T19) GPMC0_BE1n.GPIO0_36 Pin not configured */
		>;
	};
	mygpio037_notconf_pins_default: mygpio037_notconf-default-pins {
		pinctrl-single,pins = <
			AM64X_IOPAD(0x0098, PIN_DEBOUNCE_DISABLE|PIN_OUTPUT|PIN_DRIVE_STRENGTH_NOMINAL|PIN_SCMITT_TRIGGER_ENABLE, 7) /* (W19) GPMC0_WAIT0.GPIO0_37 Pin not configured */
		>;
	};
	mygpio038_notconf_pins_default: mygpio038_notconf-default-pins {
		pinctrl-single,pins = <
			AM64X_IOPAD(0x009c, PIN_DEBOUNCE_DISABLE|PIN_OUTPUT|PIN_DRIVE_STRENGTH_NOMINAL|PIN_SCMITT_TRIGGER_ENABLE, 7) /* (Y18) GPMC0_WAIT1.GPIO0_38 Pin not configured */
		>;
	};
	mygpio039_notconf_pins_default: mygpio039_notconf-default-pins {
		pinctrl-single,pins = <
			AM64X_IOPAD(0x00a0, PIN_DEBOUNCE_DISABLE|PIN_OUTPUT|PIN_DRIVE_STRENGTH_NOMINAL|PIN_SCMITT_TRIGGER_ENABLE, 7) /* (N16) GPMC0_WPn.GPIO0_39 Pin not configured */
		>;
	};
	mygpio040_notconf_pins_default: mygpio040_notconf-default-pins {
		pinctrl-single,pins = <
			AM64X_IOPAD(0x00a4, PIN_DEBOUNCE_DISABLE|PIN_OUTPUT|PIN_DRIVE_STRENGTH_NOMINAL|PIN_SCMITT_TRIGGER_ENABLE, 7) /* (N17) GPMC0_DIR.GPIO0_40 Pin not configured */
		>;
	};
	mygpio041_notconf_pins_default: mygpio041_notconf-default-pins {
		pinctrl-single,pins = <
			AM64X_IOPAD(0x00a8, PIN_DEBOUNCE_DISABLE|PIN_OUTPUT|PIN_DRIVE_STRENGTH_NOMINAL|PIN_SCMITT_TRIGGER_ENABLE, 7) /* (R19) GPMC0_CSn0.GPIO0_41 Pin not configured */
		>;
	};
	mygpio042_notconf_pins_default: mygpio042_notconf-default-pins {
		pinctrl-single,pins = <
			AM64X_IOPAD(0x00ac, PIN_DEBOUNCE_DISABLE|PIN_OUTPUT|PIN_DRIVE_STRENGTH_NOMINAL|PIN_SCMITT_TRIGGER_ENABLE, 7) /* (R20) GPMC0_CSn1.GPIO0_42 Pin not configured */
		>;
	};
	mygpio043_notconf_pins_default: mygpio043_notconf-default-pins {
		pinctrl-single,pins = <
			AM64X_IOPAD(0x00b0, PIN_DEBOUNCE_DISABLE|PIN_OUTPUT|PIN_DRIVE_STRENGTH_NOMINAL|PIN_SCMITT_TRIGGER_ENABLE, 7) /* (P19) GPMC0_CSn2.GPIO0_43 Pin not configured */
		>;
	};
	mygpio044_notconf_pins_default: mygpio044_notconf-default-pins {
		pinctrl-single,pins = <
			AM64X_IOPAD(0x00b4, PIN_DEBOUNCE_DISABLE|PIN_OUTPUT|PIN_DRIVE_STRENGTH_NOMINAL|PIN_SCMITT_TRIGGER_ENABLE, 7) /* (R21) GPMC0_CSn3.GPIO0_44 Pin not configured */
		>;
	};
	mygpio045_notconf_pins_default: mygpio045_notconf-default-pins {
		pinctrl-single,pins = <
			AM64X_IOPAD(0x00b8, PIN_DEBOUNCE_DISABLE|PIN_OUTPUT|PIN_DRIVE_STRENGTH_NOMINAL|PIN_SCMITT_TRIGGER_ENABLE, 7) /* (Y7) PRG1_PRU0_GPO0.GPIO0_45 Pin not configured */
		>;
	};
	mygpio046_notconf_pins_default: mygpio046_notconf-default-pins {
		pinctrl-single,pins = <
			AM64X_IOPAD(0x00bc, PIN_DEBOUNCE_DISABLE|PIN_OUTPUT|PIN_DRIVE_STRENGTH_NOMINAL|PIN_SCMITT_TRIGGER_ENABLE, 7) /* (U8) PRG1_PRU0_GPO1.GPIO0_46 Pin not configured */
		>;
	};
	mygpio047_notconf_pins_default: mygpio047_notconf-default-pins {
		pinctrl-single,pins = <
			AM64X_IOPAD(0x00c0, PIN_DEBOUNCE_DISABLE|PIN_OUTPUT|PIN_DRIVE_STRENGTH_NOMINAL|PIN_SCMITT_TRIGGER_ENABLE, 7) /* (W8) PRG1_PRU0_GPO2.GPIO0_47 Pin not configured */
		>;
	};
	mygpio048_notconf_pins_default: mygpio048_notconf-default-pins {
		pinctrl-single,pins = <
			AM64X_IOPAD(0x00c4, PIN_DEBOUNCE_DISABLE|PIN_OUTPUT|PIN_DRIVE_STRENGTH_NOMINAL|PIN_SCMITT_TRIGGER_ENABLE, 7) /* (V8) PRG1_PRU0_GPO3.GPIO0_48 Pin not configured */
		>;
	};
	mygpio049_notconf_pins_default: mygpio049_notconf-default-pins {
		pinctrl-single,pins = <
			AM64X_IOPAD(0x00c8, PIN_DEBOUNCE_DISABLE|PIN_OUTPUT|PIN_DRIVE_STRENGTH_NOMINAL|PIN_SCMITT_TRIGGER_ENABLE, 7) /* (Y8) PRG1_PRU0_GPO4.GPIO0_49 Pin not configured */
		>;
	};
	mygpio050_notconf_pins_default: mygpio050_notconf-default-pins {
		pinctrl-single,pins = <
			AM64X_IOPAD(0x00cc, PIN_DEBOUNCE_DISABLE|PIN_OUTPUT|PIN_DRIVE_STRENGTH_NOMINAL|PIN_SCMITT_TRIGGER_ENABLE, 7) /* (V13) PRG1_PRU0_GPO5.GPIO0_50 Pin not configured */
		>;
	};
	mygpio051_notconf_pins_default: mygpio051_notconf-default-pins {
		pinctrl-single,pins = <
			AM64X_IOPAD(0x00d0, PIN_DEBOUNCE_DISABLE|PIN_OUTPUT|PIN_DRIVE_STRENGTH_NOMINAL|PIN_SCMITT_TRIGGER_ENABLE, 7) /* (AA7) PRG1_PRU0_GPO6.GPIO0_51 Pin not configured */
		>;
	};
	mygpio052_notconf_pins_default: mygpio052_notconf-default-pins {
		pinctrl-single,pins = <
			AM64X_IOPAD(0x00d4, PIN_DEBOUNCE_DISABLE|PIN_OUTPUT|PIN_DRIVE_STRENGTH_NOMINAL|PIN_SCMITT_TRIGGER_ENABLE, 7) /* (U13) PRG1_PRU0_GPO7.GPIO0_52 Pin not configured */
		>;
	};
	mygpio053_notconf_pins_default: mygpio053_notconf-default-pins {
		pinctrl-single,pins = <
			AM64X_IOPAD(0x00d8, PIN_DEBOUNCE_DISABLE|PIN_OUTPUT|PIN_DRIVE_STRENGTH_NOMINAL|PIN_SCMITT_TRIGGER_ENABLE, 7) /* (W13) PRG1_PRU0_GPO8.GPIO0_53 Pin not configured */
		>;
	};
	mygpio054_notconf_pins_default: mygpio054_notconf-default-pins {
		pinctrl-single,pins = <
			AM64X_IOPAD(0x00dc, PIN_DEBOUNCE_DISABLE|PIN_OUTPUT|PIN_DRIVE_STRENGTH_NOMINAL|PIN_SCMITT_TRIGGER_ENABLE, 7) /* (U15) PRG1_PRU0_GPO9.GPIO0_54 Pin not configured */
		>;
	};
	mygpio055_notconf_pins_default: mygpio055_notconf-default-pins {
		pinctrl-single,pins = <
			AM64X_IOPAD(0x00e0, PIN_DEBOUNCE_DISABLE|PIN_OUTPUT|PIN_DRIVE_STRENGTH_NOMINAL|PIN_SCMITT_TRIGGER_ENABLE, 7) /* (U14) PRG1_PRU0_GPO10.GPIO0_55 Pin not configured */
		>;
	};
	mygpio056_notconf_pins_default: mygpio056_notconf-default-pins {
		pinctrl-single,pins = <
			AM64X_IOPAD(0x00e4, PIN_DEBOUNCE_DISABLE|PIN_OUTPUT|PIN_DRIVE_STRENGTH_NOMINAL|PIN_SCMITT_TRIGGER_ENABLE, 7) /* (AA8) PRG1_PRU0_GPO11.GPIO0_56 Pin not configured */
		>;
	};
	mygpio057_notconf_pins_default: mygpio057_notconf-default-pins {
		pinctrl-single,pins = <
			AM64X_IOPAD(0x00e8, PIN_DEBOUNCE_DISABLE|PIN_OUTPUT|PIN_DRIVE_STRENGTH_NOMINAL|PIN_SCMITT_TRIGGER_ENABLE, 7) /* (U9) PRG1_PRU0_GPO12.GPIO0_57 Pin not configured */
		>;
	};
	mygpio058_notconf_pins_default: mygpio058_notconf-default-pins {
		pinctrl-single,pins = <
			AM64X_IOPAD(0x00ec, PIN_DEBOUNCE_DISABLE|PIN_OUTPUT|PIN_DRIVE_STRENGTH_NOMINAL|PIN_SCMITT_TRIGGER_ENABLE, 7) /* (W9) PRG1_PRU0_GPO13.GPIO0_58 Pin not configured */
		>;
	};
	mygpio059_notconf_pins_default: mygpio059_notconf-default-pins {
		pinctrl-single,pins = <
			AM64X_IOPAD(0x00f0, PIN_DEBOUNCE_DISABLE|PIN_OUTPUT|PIN_DRIVE_STRENGTH_NOMINAL|PIN_SCMITT_TRIGGER_ENABLE, 7) /* (AA9) PRG1_PRU0_GPO14.GPIO0_59 Pin not configured */
		>;
	};
	mygpio060_notconf_pins_default: mygpio060_notconf-default-pins {
		pinctrl-single,pins = <
			AM64X_IOPAD(0x00f4, PIN_DEBOUNCE_DISABLE|PIN_OUTPUT|PIN_DRIVE_STRENGTH_NOMINAL|PIN_SCMITT_TRIGGER_ENABLE, 7) /* (Y9) PRG1_PRU0_GPO15.GPIO0_60 Pin not configured */
		>;
	};
	mygpio061_notconf_pins_default: mygpio061_notconf-default-pins {
		pinctrl-single,pins = <
			AM64X_IOPAD(0x00f8, PIN_DEBOUNCE_DISABLE|PIN_OUTPUT|PIN_DRIVE_STRENGTH_NOMINAL|PIN_SCMITT_TRIGGER_ENABLE, 7) /* (V9) PRG1_PRU0_GPO16.GPIO0_61 Pin not configured */
		>;
	};
	mygpio062_notconf_pins_default: mygpio062_notconf-default-pins {
		pinctrl-single,pins = <
			AM64X_IOPAD(0x00fc, PIN_DEBOUNCE_DISABLE|PIN_OUTPUT|PIN_DRIVE_STRENGTH_NOMINAL|PIN_SCMITT_TRIGGER_ENABLE, 7) /* (U7) PRG1_PRU0_GPO17.GPIO0_62 Pin not configured */
		>;
	};
	mygpio063_notconf_pins_default: mygpio063_notconf-default-pins {
		pinctrl-single,pins = <
			AM64X_IOPAD(0x0100, PIN_DEBOUNCE_DISABLE|PIN_OUTPUT|PIN_DRIVE_STRENGTH_NOMINAL|PIN_SCMITT_TRIGGER_ENABLE, 7) /* (V7) PRG1_PRU0_GPO18.GPIO0_63 Pin not configured */
		>;
	};
	mygpio064_notconf_pins_default: mygpio064_notconf-default-pins {
		pinctrl-single,pins = <
			AM64X_IOPAD(0x0104, PIN_DEBOUNCE_DISABLE|PIN_OUTPUT|PIN_DRIVE_STRENGTH_NOMINAL|PIN_SCMITT_TRIGGER_ENABLE, 7) /* (W7) PRG1_PRU0_GPO19.GPIO0_64 Pin not configured */
		>;
	};
	mygpio065_notconf_pins_default: mygpio065_notconf-default-pins {
		pinctrl-single,pins = <
			AM64X_IOPAD(0x0108, PIN_DEBOUNCE_DISABLE|PIN_OUTPUT|PIN_DRIVE_STRENGTH_NOMINAL|PIN_SCMITT_TRIGGER_ENABLE, 7) /* (W11) PRG1_PRU1_GPO0.GPIO0_65 Pin not configured */
		>;
	};
	mygpio066_notconf_pins_default: mygpio066_notconf-default-pins {
		pinctrl-single,pins = <
			AM64X_IOPAD(0x010c, PIN_DEBOUNCE_DISABLE|PIN_OUTPUT|PIN_DRIVE_STRENGTH_NOMINAL|PIN_SCMITT_TRIGGER_ENABLE, 7) /* (V11) PRG1_PRU1_GPO1.GPIO0_66 Pin not configured */
		>;
	};
	mygpio067_notconf_pins_default: mygpio067_notconf-default-pins {
		pinctrl-single,pins = <
			AM64X_IOPAD(0x0110, PIN_DEBOUNCE_DISABLE|PIN_OUTPUT|PIN_DRIVE_STRENGTH_NOMINAL|PIN_SCMITT_TRIGGER_ENABLE, 7) /* (AA12) PRG1_PRU1_GPO2.GPIO0_67 Pin not configured */
		>;
	};
	mygpio068_notconf_pins_default: mygpio068_notconf-default-pins {
		pinctrl-single,pins = <
			AM64X_IOPAD(0x0114, PIN_DEBOUNCE_DISABLE|PIN_OUTPUT|PIN_DRIVE_STRENGTH_NOMINAL|PIN_SCMITT_TRIGGER_ENABLE, 7) /* (Y12) PRG1_PRU1_GPO3.GPIO0_68 Pin not configured */
		>;
	};
	mygpio069_notconf_pins_default: mygpio069_notconf-default-pins {
		pinctrl-single,pins = <
			AM64X_IOPAD(0x0118, PIN_DEBOUNCE_DISABLE|PIN_OUTPUT|PIN_DRIVE_STRENGTH_NOMINAL|PIN_SCMITT_TRIGGER_ENABLE, 7) /* (W12) PRG1_PRU1_GPO4.GPIO0_69 Pin not configured */
		>;
	};
	mygpio070_notconf_pins_default: mygpio070_notconf-default-pins {
		pinctrl-single,pins = <
			AM64X_IOPAD(0x011c, PIN_DEBOUNCE_DISABLE|PIN_OUTPUT|PIN_DRIVE_STRENGTH_NOMINAL|PIN_SCMITT_TRIGGER_ENABLE, 7) /* (AA13) PRG1_PRU1_GPO5.GPIO0_70 Pin not configured */
		>;
	};
	mygpio071_notconf_pins_default: mygpio071_notconf-default-pins {
		pinctrl-single,pins = <
			AM64X_IOPAD(0x0120, PIN_DEBOUNCE_DISABLE|PIN_OUTPUT|PIN_DRIVE_STRENGTH_NOMINAL|PIN_SCMITT_TRIGGER_ENABLE, 7) /* (U11) PRG1_PRU1_GPO6.GPIO0_71 Pin not configured */
		>;
	};
	mygpio072_notconf_pins_default: mygpio072_notconf-default-pins {
		pinctrl-single,pins = <
			AM64X_IOPAD(0x0124, PIN_DEBOUNCE_DISABLE|PIN_OUTPUT|PIN_DRIVE_STRENGTH_NOMINAL|PIN_SCMITT_TRIGGER_ENABLE, 7) /* (V15) PRG1_PRU1_GPO7.GPIO0_72 Pin not configured */
		>;
	};
	mygpio073_notconf_pins_default: mygpio073_notconf-default-pins {
		pinctrl-single,pins = <
			AM64X_IOPAD(0x0128, PIN_DEBOUNCE_DISABLE|PIN_OUTPUT|PIN_DRIVE_STRENGTH_NOMINAL|PIN_SCMITT_TRIGGER_ENABLE, 7) /* (U12) PRG1_PRU1_GPO8.GPIO0_73 Pin not configured */
		>;
	};
	mygpio074_notconf_pins_default: mygpio074_notconf-default-pins {
		pinctrl-single,pins = <
			AM64X_IOPAD(0x012c, PIN_DEBOUNCE_DISABLE|PIN_OUTPUT|PIN_DRIVE_STRENGTH_NOMINAL|PIN_SCMITT_TRIGGER_ENABLE, 7) /* (V14) PRG1_PRU1_GPO9.GPIO0_74 Pin not configured */
		>;
	};
	mygpio075_notconf_pins_default: mygpio075_notconf-default-pins {
		pinctrl-single,pins = <
			AM64X_IOPAD(0x0130, PIN_DEBOUNCE_DISABLE|PIN_OUTPUT|PIN_DRIVE_STRENGTH_NOMINAL|PIN_SCMITT_TRIGGER_ENABLE, 7) /* (W14) PRG1_PRU1_GPO10.GPIO0_75 Pin not configured */
		>;
	};
	mygpio076_notconf_pins_default: mygpio076_notconf-default-pins {
		pinctrl-single,pins = <
			AM64X_IOPAD(0x0134, PIN_DEBOUNCE_DISABLE|PIN_OUTPUT|PIN_DRIVE_STRENGTH_NOMINAL|PIN_SCMITT_TRIGGER_ENABLE, 7) /* (AA10) PRG1_PRU1_GPO11.GPIO0_76 Pin not configured */
		>;
	};
	mygpio077_notconf_pins_default: mygpio077_notconf-default-pins {
		pinctrl-single,pins = <
			AM64X_IOPAD(0x0138, PIN_DEBOUNCE_DISABLE|PIN_OUTPUT|PIN_DRIVE_STRENGTH_NOMINAL|PIN_SCMITT_TRIGGER_ENABLE, 7) /* (V10) PRG1_PRU1_GPO12.GPIO0_77 Pin not configured */
		>;
	};
	mygpio078_notconf_pins_default: mygpio078_notconf-default-pins {
		pinctrl-single,pins = <
			AM64X_IOPAD(0x013c, PIN_DEBOUNCE_DISABLE|PIN_OUTPUT|PIN_DRIVE_STRENGTH_NOMINAL|PIN_SCMITT_TRIGGER_ENABLE, 7) /* (U10) PRG1_PRU1_GPO13.GPIO0_78 Pin not configured */
		>;
	};
	mygpio079_notconf_pins_default: mygpio079_notconf-default-pins {
		pinctrl-single,pins = <
			AM64X_IOPAD(0x0140, PIN_DEBOUNCE_DISABLE|PIN_OUTPUT|PIN_DRIVE_STRENGTH_NOMINAL|PIN_SCMITT_TRIGGER_ENABLE, 7) /* (AA11) PRG1_PRU1_GPO14.GPIO0_79 Pin not configured */
		>;
	};
	mygpio080_notconf_pins_default: mygpio080_notconf-default-pins {
		pinctrl-single,pins = <
			AM64X_IOPAD(0x0144, PIN_DEBOUNCE_DISABLE|PIN_OUTPUT|PIN_DRIVE_STRENGTH_NOMINAL|PIN_SCMITT_TRIGGER_ENABLE, 7) /* (Y11) PRG1_PRU1_GPO15.GPIO0_80 Pin not configured */
		>;
	};
	mygpio081_notconf_pins_default: mygpio081_notconf-default-pins {
		pinctrl-single,pins = <
			AM64X_IOPAD(0x0148, PIN_DEBOUNCE_DISABLE|PIN_OUTPUT|PIN_DRIVE_STRENGTH_NOMINAL|PIN_SCMITT_TRIGGER_ENABLE, 7) /* (Y10) PRG1_PRU1_GPO16.GPIO0_81 Pin not configured */
		>;
	};
	mygpio019_notconf_pins_default: mygpio019_notconf-default-pins {
		pinctrl-single,pins = <
			AM64X_IOPAD(0x014c, PIN_DEBOUNCE_DISABLE|PIN_OUTPUT|PIN_DRIVE_STRENGTH_NOMINAL|PIN_SCMITT_TRIGGER_ENABLE, 7) /* (AA14) PRG1_PRU1_GPO17.GPIO0_19 Pin not configured */
		>;
	};
	mygpio020_notconf_pins_default: mygpio020_notconf-default-pins {
		pinctrl-single,pins = <
			AM64X_IOPAD(0x0150, PIN_DEBOUNCE_DISABLE|PIN_OUTPUT|PIN_DRIVE_STRENGTH_NOMINAL|PIN_SCMITT_TRIGGER_ENABLE, 7) /* (Y13) PRG1_PRU1_GPO18.GPIO0_20 Pin not configured */
		>;
	};
	mygpio084_notconf_pins_default: mygpio084_notconf-default-pins {
		pinctrl-single,pins = <
			AM64X_IOPAD(0x0154, PIN_DEBOUNCE_DISABLE|PIN_OUTPUT|PIN_DRIVE_STRENGTH_NOMINAL|PIN_SCMITT_TRIGGER_ENABLE, 7) /* (V12) PRG1_PRU1_GPO19.GPIO0_84 Pin not configured */
		>;
	};
	mygpio085_notconf_pins_default: mygpio085_notconf-default-pins {
		pinctrl-single,pins = <
			AM64X_IOPAD(0x0158, PIN_DEBOUNCE_DISABLE|PIN_OUTPUT|PIN_DRIVE_STRENGTH_NOMINAL|PIN_SCMITT_TRIGGER_ENABLE, 7) /* (AA6) PRG1_MDIO0_MDIO.GPIO0_85 Pin not configured */
		>;
	};
	mygpio086_notconf_pins_default: mygpio086_notconf-default-pins {
		pinctrl-single,pins = <
			AM64X_IOPAD(0x015c, PIN_DEBOUNCE_DISABLE|PIN_OUTPUT|PIN_DRIVE_STRENGTH_NOMINAL|PIN_SCMITT_TRIGGER_ENABLE, 7) /* (Y6) PRG1_MDIO0_MDC.GPIO0_86 Pin not configured */
		>;
	};
	mygpio10_notconf_pins_default: mygpio10_notconf-default-pins {
		pinctrl-single,pins = <
			AM64X_IOPAD(0x0160, PIN_DEBOUNCE_DISABLE|PIN_OUTPUT|PIN_DRIVE_STRENGTH_NOMINAL|PIN_SCMITT_TRIGGER_ENABLE, 7) /* (Y1) PRG0_PRU0_GPO0.GPIO1_0 Pin not configured */
		>;
	};
	mygpio11_notconf_pins_default: mygpio11_notconf-default-pins {
		pinctrl-single,pins = <
			AM64X_IOPAD(0x0164, PIN_DEBOUNCE_DISABLE|PIN_OUTPUT|PIN_DRIVE_STRENGTH_NOMINAL|PIN_SCMITT_TRIGGER_ENABLE, 7) /* (R4) PRG0_PRU0_GPO1.GPIO1_1 Pin not configured */
		>;
	};
	mygpio12_notconf_pins_default: mygpio12_notconf-default-pins {
		pinctrl-single,pins = <
			AM64X_IOPAD(0x0168, PIN_DEBOUNCE_DISABLE|PIN_OUTPUT|PIN_DRIVE_STRENGTH_NOMINAL|PIN_SCMITT_TRIGGER_ENABLE, 7) /* (U2) PRG0_PRU0_GPO2.GPIO1_2 Pin not configured */
		>;
	};
	mygpio13_notconf_pins_default: mygpio13_notconf-default-pins {
		pinctrl-single,pins = <
			AM64X_IOPAD(0x016c, PIN_DEBOUNCE_DISABLE|PIN_OUTPUT|PIN_DRIVE_STRENGTH_NOMINAL|PIN_SCMITT_TRIGGER_ENABLE, 7) /* (V2) PRG0_PRU0_GPO3.GPIO1_3 Pin not configured */
		>;
	};
	mygpio14_notconf_pins_default: mygpio14_notconf-default-pins {
		pinctrl-single,pins = <
			AM64X_IOPAD(0x0170, PIN_DEBOUNCE_DISABLE|PIN_OUTPUT|PIN_DRIVE_STRENGTH_NOMINAL|PIN_SCMITT_TRIGGER_ENABLE, 7) /* (AA2) PRG0_PRU0_GPO4.GPIO1_4 Pin not configured */
		>;
	};
	mygpio15_notconf_pins_default: mygpio15_notconf-default-pins {
		pinctrl-single,pins = <
			AM64X_IOPAD(0x0174, PIN_DEBOUNCE_DISABLE|PIN_OUTPUT|PIN_DRIVE_STRENGTH_NOMINAL|PIN_SCMITT_TRIGGER_ENABLE, 7) /* (R3) PRG0_PRU0_GPO5.GPIO1_5 Pin not configured */
		>;
	};
	mygpio16_notconf_pins_default: mygpio16_notconf-default-pins {
		pinctrl-single,pins = <
			AM64X_IOPAD(0x0178, PIN_DEBOUNCE_DISABLE|PIN_OUTPUT|PIN_DRIVE_STRENGTH_NOMINAL|PIN_SCMITT_TRIGGER_ENABLE, 7) /* (T3) PRG0_PRU0_GPO6.GPIO1_6 Pin not configured */
		>;
	};
	mygpio17_notconf_pins_default: mygpio17_notconf-default-pins {
		pinctrl-single,pins = <
			AM64X_IOPAD(0x017c, PIN_DEBOUNCE_DISABLE|PIN_OUTPUT|PIN_DRIVE_STRENGTH_NOMINAL|PIN_SCMITT_TRIGGER_ENABLE, 7) /* (T1) PRG0_PRU0_GPO7.GPIO1_7 Pin not configured */
		>;
	};
	mygpio18_notconf_pins_default: mygpio18_notconf-default-pins {
		pinctrl-single,pins = <
			AM64X_IOPAD(0x0180, PIN_DEBOUNCE_DISABLE|PIN_OUTPUT|PIN_DRIVE_STRENGTH_NOMINAL|PIN_SCMITT_TRIGGER_ENABLE, 7) /* (T2) PRG0_PRU0_GPO8.GPIO1_8 Pin not configured */
		>;
	};
	mygpio19_notconf_pins_default: mygpio19_notconf-default-pins {
		pinctrl-single,pins = <
			AM64X_IOPAD(0x0184, PIN_DEBOUNCE_DISABLE|PIN_OUTPUT|PIN_DRIVE_STRENGTH_NOMINAL|PIN_SCMITT_TRIGGER_ENABLE, 7) /* (W6) PRG0_PRU0_GPO9.GPIO1_9 Pin not configured */
		>;
	};
	mygpio110_notconf_pins_default: mygpio110_notconf-default-pins {
		pinctrl-single,pins = <
			AM64X_IOPAD(0x0188, PIN_DEBOUNCE_DISABLE|PIN_OUTPUT|PIN_DRIVE_STRENGTH_NOMINAL|PIN_SCMITT_TRIGGER_ENABLE, 7) /* (AA5) PRG0_PRU0_GPO10.GPIO1_10 Pin not configured */
		>;
	};
	mygpio111_notconf_pins_default: mygpio111_notconf-default-pins {
		pinctrl-single,pins = <
			AM64X_IOPAD(0x018c, PIN_DEBOUNCE_DISABLE|PIN_OUTPUT|PIN_DRIVE_STRENGTH_NOMINAL|PIN_SCMITT_TRIGGER_ENABLE, 7) /* (Y3) PRG0_PRU0_GPO11.GPIO1_11 Pin not configured */
		>;
	};
	mygpio112_notconf_pins_default: mygpio112_notconf-default-pins {
		pinctrl-single,pins = <
			AM64X_IOPAD(0x0190, PIN_DEBOUNCE_DISABLE|PIN_OUTPUT|PIN_DRIVE_STRENGTH_NOMINAL|PIN_SCMITT_TRIGGER_ENABLE, 7) /* (AA3) PRG0_PRU0_GPO12.GPIO1_12 Pin not configured */
		>;
	};
	mygpio113_notconf_pins_default: mygpio113_notconf-default-pins {
		pinctrl-single,pins = <
			AM64X_IOPAD(0x0194, PIN_DEBOUNCE_DISABLE|PIN_OUTPUT|PIN_DRIVE_STRENGTH_NOMINAL|PIN_SCMITT_TRIGGER_ENABLE, 7) /* (R6) PRG0_PRU0_GPO13.GPIO1_13 Pin not configured */
		>;
	};
	mygpio114_notconf_pins_default: mygpio114_notconf-default-pins {
		pinctrl-single,pins = <
			AM64X_IOPAD(0x0198, PIN_DEBOUNCE_DISABLE|PIN_OUTPUT|PIN_DRIVE_STRENGTH_NOMINAL|PIN_SCMITT_TRIGGER_ENABLE, 7) /* (V4) PRG0_PRU0_GPO14.GPIO1_14 Pin not configured */
		>;
	};
	mygpio115_notconf_pins_default: mygpio115_notconf-default-pins {
		pinctrl-single,pins = <
			AM64X_IOPAD(0x019c, PIN_DEBOUNCE_DISABLE|PIN_OUTPUT|PIN_DRIVE_STRENGTH_NOMINAL|PIN_SCMITT_TRIGGER_ENABLE, 7) /* (T5) PRG0_PRU0_GPO15.GPIO1_15 Pin not configured */
		>;
	};
	mygpio116_notconf_pins_default: mygpio116_notconf-default-pins {
		pinctrl-single,pins = <
			AM64X_IOPAD(0x01a0, PIN_DEBOUNCE_DISABLE|PIN_OUTPUT|PIN_DRIVE_STRENGTH_NOMINAL|PIN_SCMITT_TRIGGER_ENABLE, 7) /* (U4) PRG0_PRU0_GPO16.GPIO1_16 Pin not configured */
		>;
	};
	mygpio117_notconf_pins_default: mygpio117_notconf-default-pins {
		pinctrl-single,pins = <
			AM64X_IOPAD(0x01a4, PIN_DEBOUNCE_DISABLE|PIN_OUTPUT|PIN_DRIVE_STRENGTH_NOMINAL|PIN_SCMITT_TRIGGER_ENABLE, 7) /* (U1) PRG0_PRU0_GPO17.GPIO1_17 Pin not configured */
		>;
	};
	mygpio118_notconf_pins_default: mygpio118_notconf-default-pins {
		pinctrl-single,pins = <
			AM64X_IOPAD(0x01a8, PIN_DEBOUNCE_DISABLE|PIN_OUTPUT|PIN_DRIVE_STRENGTH_NOMINAL|PIN_SCMITT_TRIGGER_ENABLE, 7) /* (V1) PRG0_PRU0_GPO18.GPIO1_18 Pin not configured */
		>;
	};
	mygpio119_notconf_pins_default: mygpio119_notconf-default-pins {
		pinctrl-single,pins = <
			AM64X_IOPAD(0x01ac, PIN_DEBOUNCE_DISABLE|PIN_OUTPUT|PIN_DRIVE_STRENGTH_NOMINAL|PIN_SCMITT_TRIGGER_ENABLE, 7) /* (W1) PRG0_PRU0_GPO19.GPIO1_19 Pin not configured */
		>;
	};
	mygpio120_notconf_pins_default: mygpio120_notconf-default-pins {
		pinctrl-single,pins = <
			AM64X_IOPAD(0x01b0, PIN_DEBOUNCE_DISABLE|PIN_OUTPUT|PIN_DRIVE_STRENGTH_NOMINAL|PIN_SCMITT_TRIGGER_ENABLE, 7) /* (Y2) PRG0_PRU1_GPO0.GPIO1_20 Pin not configured */
		>;
	};
	mygpio121_notconf_pins_default: mygpio121_notconf-default-pins {
		pinctrl-single,pins = <
			AM64X_IOPAD(0x01b4, PIN_DEBOUNCE_DISABLE|PIN_OUTPUT|PIN_DRIVE_STRENGTH_NOMINAL|PIN_SCMITT_TRIGGER_ENABLE, 7) /* (W2) PRG0_PRU1_GPO1.GPIO1_21 Pin not configured */
		>;
	};
	mygpio122_notconf_pins_default: mygpio122_notconf-default-pins {
		pinctrl-single,pins = <
			AM64X_IOPAD(0x01b8, PIN_DEBOUNCE_DISABLE|PIN_OUTPUT|PIN_DRIVE_STRENGTH_NOMINAL|PIN_SCMITT_TRIGGER_ENABLE, 7) /* (V3) PRG0_PRU1_GPO2.GPIO1_22 Pin not configured */
		>;
	};
	mygpio123_notconf_pins_default: mygpio123_notconf-default-pins {
		pinctrl-single,pins = <
			AM64X_IOPAD(0x01bc, PIN_DEBOUNCE_DISABLE|PIN_OUTPUT|PIN_DRIVE_STRENGTH_NOMINAL|PIN_SCMITT_TRIGGER_ENABLE, 7) /* (T4) PRG0_PRU1_GPO3.GPIO1_23 Pin not configured */
		>;
	};
	mygpio124_notconf_pins_default: mygpio124_notconf-default-pins {
		pinctrl-single,pins = <
			AM64X_IOPAD(0x01c0, PIN_DEBOUNCE_DISABLE|PIN_OUTPUT|PIN_DRIVE_STRENGTH_NOMINAL|PIN_SCMITT_TRIGGER_ENABLE, 7) /* (W3) PRG0_PRU1_GPO4.GPIO1_24 Pin not configured */
		>;
	};
	mygpio125_notconf_pins_default: mygpio125_notconf-default-pins {
		pinctrl-single,pins = <
			AM64X_IOPAD(0x01c4, PIN_DEBOUNCE_DISABLE|PIN_OUTPUT|PIN_DRIVE_STRENGTH_NOMINAL|PIN_SCMITT_TRIGGER_ENABLE, 7) /* (P4) PRG0_PRU1_GPO5.GPIO1_25 Pin not configured */
		>;
	};
	mygpio126_notconf_pins_default: mygpio126_notconf-default-pins {
		pinctrl-single,pins = <
			AM64X_IOPAD(0x01c8, PIN_DEBOUNCE_DISABLE|PIN_OUTPUT|PIN_DRIVE_STRENGTH_NOMINAL|PIN_SCMITT_TRIGGER_ENABLE, 7) /* (R5) PRG0_PRU1_GPO6.GPIO1_26 Pin not configured */
		>;
	};
	mygpio127_notconf_pins_default: mygpio127_notconf-default-pins {
		pinctrl-single,pins = <
			AM64X_IOPAD(0x01cc, PIN_DEBOUNCE_DISABLE|PIN_OUTPUT|PIN_DRIVE_STRENGTH_NOMINAL|PIN_SCMITT_TRIGGER_ENABLE, 7) /* (W5) PRG0_PRU1_GPO7.GPIO1_27 Pin not configured */
		>;
	};
	mygpio128_notconf_pins_default: mygpio128_notconf-default-pins {
		pinctrl-single,pins = <
			AM64X_IOPAD(0x01d0, PIN_DEBOUNCE_DISABLE|PIN_OUTPUT|PIN_DRIVE_STRENGTH_NOMINAL|PIN_SCMITT_TRIGGER_ENABLE, 7) /* (R1) PRG0_PRU1_GPO8.GPIO1_28 Pin not configured */
		>;
	};
	mygpio129_notconf_pins_default: mygpio129_notconf-default-pins {
		pinctrl-single,pins = <
			AM64X_IOPAD(0x01d4, PIN_DEBOUNCE_DISABLE|PIN_OUTPUT|PIN_DRIVE_STRENGTH_NOMINAL|PIN_SCMITT_TRIGGER_ENABLE, 7) /* (Y5) PRG0_PRU1_GPO9.GPIO1_29 Pin not configured */
		>;
	};
	mygpio130_notconf_pins_default: mygpio130_notconf-default-pins {
		pinctrl-single,pins = <
			AM64X_IOPAD(0x01d8, PIN_DEBOUNCE_DISABLE|PIN_OUTPUT|PIN_DRIVE_STRENGTH_NOMINAL|PIN_SCMITT_TRIGGER_ENABLE, 7) /* (V6) PRG0_PRU1_GPO10.GPIO1_30 Pin not configured */
		>;
	};
	mygpio131_notconf_pins_default: mygpio131_notconf-default-pins {
		pinctrl-single,pins = <
			AM64X_IOPAD(0x01dc, PIN_DEBOUNCE_DISABLE|PIN_OUTPUT|PIN_DRIVE_STRENGTH_NOMINAL|PIN_SCMITT_TRIGGER_ENABLE, 7) /* (W4) PRG0_PRU1_GPO11.GPIO1_31 Pin not configured */
		>;
	};
	mygpio132_notconf_pins_default: mygpio132_notconf-default-pins {
		pinctrl-single,pins = <
			AM64X_IOPAD(0x01e0, PIN_DEBOUNCE_DISABLE|PIN_OUTPUT|PIN_DRIVE_STRENGTH_NOMINAL|PIN_SCMITT_TRIGGER_ENABLE, 7) /* (Y4) PRG0_PRU1_GPO12.GPIO1_32 Pin not configured */
		>;
	};
	mygpio133_notconf_pins_default: mygpio133_notconf-default-pins {
		pinctrl-single,pins = <
			AM64X_IOPAD(0x01e4, PIN_DEBOUNCE_DISABLE|PIN_OUTPUT|PIN_DRIVE_STRENGTH_NOMINAL|PIN_SCMITT_TRIGGER_ENABLE, 7) /* (T6) PRG0_PRU1_GPO13.GPIO1_33 Pin not configured */
		>;
	};
	mygpio134_notconf_pins_default: mygpio134_notconf-default-pins {
		pinctrl-single,pins = <
			AM64X_IOPAD(0x01e8, PIN_DEBOUNCE_DISABLE|PIN_OUTPUT|PIN_DRIVE_STRENGTH_NOMINAL|PIN_SCMITT_TRIGGER_ENABLE, 7) /* (U6) PRG0_PRU1_GPO14.GPIO1_34 Pin not configured */
		>;
	};
	mygpio135_notconf_pins_default: mygpio135_notconf-default-pins {
		pinctrl-single,pins = <
			AM64X_IOPAD(0x01ec, PIN_DEBOUNCE_DISABLE|PIN_OUTPUT|PIN_DRIVE_STRENGTH_NOMINAL|PIN_SCMITT_TRIGGER_ENABLE, 7) /* (U5) PRG0_PRU1_GPO15.GPIO1_35 Pin not configured */
		>;
	};
	mygpio136_notconf_pins_default: mygpio136_notconf-default-pins {
		pinctrl-single,pins = <
			AM64X_IOPAD(0x01f0, PIN_DEBOUNCE_DISABLE|PIN_OUTPUT|PIN_DRIVE_STRENGTH_NOMINAL|PIN_SCMITT_TRIGGER_ENABLE, 7) /* (AA4) PRG0_PRU1_GPO16.GPIO1_36 Pin not configured */
		>;
	};
	mygpio137_notconf_pins_default: mygpio137_notconf-default-pins {
		pinctrl-single,pins = <
			AM64X_IOPAD(0x01f4, PIN_DEBOUNCE_DISABLE|PIN_OUTPUT|PIN_DRIVE_STRENGTH_NOMINAL|PIN_SCMITT_TRIGGER_ENABLE, 7) /* (V5) PRG0_PRU1_GPO17.GPIO1_37 Pin not configured */
		>;
	};
	mygpio138_notconf_pins_default: mygpio138_notconf-default-pins {
		pinctrl-single,pins = <
			AM64X_IOPAD(0x01f8, PIN_DEBOUNCE_DISABLE|PIN_OUTPUT|PIN_DRIVE_STRENGTH_NOMINAL|PIN_SCMITT_TRIGGER_ENABLE, 7) /* (P5) PRG0_PRU1_GPO18.GPIO1_38 Pin not configured */
		>;
	};
	mygpio139_notconf_pins_default: mygpio139_notconf-default-pins {
		pinctrl-single,pins = <
			AM64X_IOPAD(0x01fc, PIN_DEBOUNCE_DISABLE|PIN_OUTPUT|PIN_DRIVE_STRENGTH_NOMINAL|PIN_SCMITT_TRIGGER_ENABLE, 7) /* (R2) PRG0_PRU1_GPO19.GPIO1_39 Pin not configured */
		>;
	};
	mygpio140_notconf_pins_default: mygpio140_notconf-default-pins {
		pinctrl-single,pins = <
			AM64X_IOPAD(0x0200, PIN_DEBOUNCE_DISABLE|PIN_OUTPUT|PIN_DRIVE_STRENGTH_NOMINAL|PIN_SCMITT_TRIGGER_ENABLE, 7) /* (P2) PRG0_MDIO0_MDIO.GPIO1_40 Pin not configured */
		>;
	};
	mygpio141_notconf_pins_default: mygpio141_notconf-default-pins {
		pinctrl-single,pins = <
			AM64X_IOPAD(0x0204, PIN_DEBOUNCE_DISABLE|PIN_OUTPUT|PIN_DRIVE_STRENGTH_NOMINAL|PIN_SCMITT_TRIGGER_ENABLE, 7) /* (P3) PRG0_MDIO0_MDC.GPIO1_41 Pin not configured */
		>;
	};
	mygpio142_notconf_pins_default: mygpio142_notconf-default-pins {
		pinctrl-single,pins = <
			AM64X_IOPAD(0x0208, PIN_DEBOUNCE_DISABLE|PIN_OUTPUT|PIN_DRIVE_STRENGTH_NOMINAL|PIN_SCMITT_TRIGGER_ENABLE, 7) /* (D12) SPI0_CS0.GPIO1_42 Pin not configured */
		>;
	};
	mygpio143_notconf_pins_default: mygpio143_notconf-default-pins {
		pinctrl-single,pins = <
			AM64X_IOPAD(0x020c, PIN_DEBOUNCE_DISABLE|PIN_OUTPUT|PIN_DRIVE_STRENGTH_NOMINAL|PIN_SCMITT_TRIGGER_ENABLE, 7) /* (C13) SPI0_CS1.GPIO1_43 Pin not configured */
		>;
	};
	mygpio144_notconf_pins_default: mygpio144_notconf-default-pins {
		pinctrl-single,pins = <
			AM64X_IOPAD(0x0210, PIN_DEBOUNCE_DISABLE|PIN_OUTPUT|PIN_DRIVE_STRENGTH_NOMINAL|PIN_SCMITT_TRIGGER_ENABLE, 7) /* (D13) SPI0_CLK.GPIO1_44 Pin not configured */
		>;
	};
	mygpio145_notconf_pins_default: mygpio145_notconf-default-pins {
		pinctrl-single,pins = <
			AM64X_IOPAD(0x0214, PIN_DEBOUNCE_DISABLE|PIN_OUTPUT|PIN_DRIVE_STRENGTH_NOMINAL|PIN_SCMITT_TRIGGER_ENABLE, 7) /* (A13) SPI0_D0.GPIO1_45 Pin not configured */
		>;
	};
	mygpio146_notconf_pins_default: mygpio146_notconf-default-pins {
		pinctrl-single,pins = <
			AM64X_IOPAD(0x0218, PIN_DEBOUNCE_DISABLE|PIN_OUTPUT|PIN_DRIVE_STRENGTH_NOMINAL|PIN_SCMITT_TRIGGER_ENABLE, 7) /* (A14) SPI0_D1.GPIO1_46 Pin not configured */
		>;
	};
	mygpio147_notconf_pins_default: mygpio147_notconf-default-pins {
		pinctrl-single,pins = <
			AM64X_IOPAD(0x021c, PIN_DEBOUNCE_DISABLE|PIN_OUTPUT|PIN_DRIVE_STRENGTH_NOMINAL|PIN_SCMITT_TRIGGER_ENABLE, 7) /* (B14) SPI1_CS0.GPIO1_47 Pin not configured */
		>;
	};
	mygpio148_notconf_pins_default: mygpio148_notconf-default-pins {
		pinctrl-single,pins = <
			AM64X_IOPAD(0x0220, PIN_DEBOUNCE_DISABLE|PIN_OUTPUT|PIN_DRIVE_STRENGTH_NOMINAL|PIN_SCMITT_TRIGGER_ENABLE, 7) /* (D14) SPI1_CS1.GPIO1_48 Pin not configured */
		>;
	};
	mygpio149_notconf_pins_default: mygpio149_notconf-default-pins {
		pinctrl-single,pins = <
			AM64X_IOPAD(0x0224, PIN_DEBOUNCE_DISABLE|PIN_OUTPUT|PIN_DRIVE_STRENGTH_NOMINAL|PIN_SCMITT_TRIGGER_ENABLE, 7) /* (C14) SPI1_CLK.GPIO1_49 Pin not configured */
		>;
	};
	mygpio150_notconf_pins_default: mygpio150_notconf-default-pins {
		pinctrl-single,pins = <
			AM64X_IOPAD(0x0228, PIN_DEBOUNCE_DISABLE|PIN_OUTPUT|PIN_DRIVE_STRENGTH_NOMINAL|PIN_SCMITT_TRIGGER_ENABLE, 7) /* (B15) SPI1_D0.GPIO1_50 Pin not configured */
		>;
	};
	mygpio151_notconf_pins_default: mygpio151_notconf-default-pins {
		pinctrl-single,pins = <
			AM64X_IOPAD(0x022c, PIN_DEBOUNCE_DISABLE|PIN_OUTPUT|PIN_DRIVE_STRENGTH_NOMINAL|PIN_SCMITT_TRIGGER_ENABLE, 7) /* (A15) SPI1_D1.GPIO1_51 Pin not configured */
		>;
	};
	mygpio152_notconf_pins_default: mygpio152_notconf-default-pins {
		pinctrl-single,pins = <
			AM64X_IOPAD(0x0230, PIN_DEBOUNCE_DISABLE|PIN_OUTPUT|PIN_DRIVE_STRENGTH_NOMINAL|PIN_SCMITT_TRIGGER_ENABLE, 7) /* (D15) UART0_RXD.GPIO1_52 Pin not configured */
		>;
	};
	mygpio153_notconf_pins_default: mygpio153_notconf-default-pins {
		pinctrl-single,pins = <
			AM64X_IOPAD(0x0234, PIN_DEBOUNCE_DISABLE|PIN_OUTPUT|PIN_DRIVE_STRENGTH_NOMINAL|PIN_SCMITT_TRIGGER_ENABLE, 7) /* (C16) UART0_TXD.GPIO1_53 Pin not configured */
		>;
	};
	mygpio154_notconf_pins_default: mygpio154_notconf-default-pins {
		pinctrl-single,pins = <
			AM64X_IOPAD(0x0238, PIN_DEBOUNCE_DISABLE|PIN_OUTPUT|PIN_DRIVE_STRENGTH_NOMINAL|PIN_SCMITT_TRIGGER_ENABLE, 7) /* (B16) UART0_CTSn.GPIO1_54 Pin not configured */
		>;
	};
	mygpio155_notconf_pins_default: mygpio155_notconf-default-pins {
		pinctrl-single,pins = <
			AM64X_IOPAD(0x023c, PIN_DEBOUNCE_DISABLE|PIN_OUTPUT|PIN_DRIVE_STRENGTH_NOMINAL|PIN_SCMITT_TRIGGER_ENABLE, 7) /* (A16) UART0_RTSn.GPIO1_55 Pin not configured */
		>;
	};
	mygpio156_notconf_pins_default: mygpio156_notconf-default-pins {
		pinctrl-single,pins = <
			AM64X_IOPAD(0x0240, PIN_DEBOUNCE_DISABLE|PIN_OUTPUT|PIN_DRIVE_STRENGTH_NOMINAL|PIN_SCMITT_TRIGGER_ENABLE, 7) /* (E15) UART1_RXD.GPIO1_56 Pin not configured */
		>;
	};
	mygpio157_notconf_pins_default: mygpio157_notconf-default-pins {
		pinctrl-single,pins = <
			AM64X_IOPAD(0x0244, PIN_DEBOUNCE_DISABLE|PIN_OUTPUT|PIN_DRIVE_STRENGTH_NOMINAL|PIN_SCMITT_TRIGGER_ENABLE, 7) /* (E14) UART1_TXD.GPIO1_57 Pin not configured */
		>;
	};
	mygpio158_notconf_pins_default: mygpio158_notconf-default-pins {
		pinctrl-single,pins = <
			AM64X_IOPAD(0x0248, PIN_DEBOUNCE_DISABLE|PIN_OUTPUT|PIN_DRIVE_STRENGTH_NOMINAL|PIN_SCMITT_TRIGGER_ENABLE, 7) /* (D16) UART1_CTSn.GPIO1_58 Pin not configured */
		>;
	};
	mygpio159_notconf_pins_default: mygpio159_notconf-default-pins {
		pinctrl-single,pins = <
			AM64X_IOPAD(0x024c, PIN_DEBOUNCE_DISABLE|PIN_OUTPUT|PIN_DRIVE_STRENGTH_NOMINAL|PIN_SCMITT_TRIGGER_ENABLE, 7) /* (E16) UART1_RTSn.GPIO1_59 Pin not configured */
		>;
	};
	mygpio160_notconf_pins_default: mygpio160_notconf-default-pins {
		pinctrl-single,pins = <
			AM64X_IOPAD(0x0250, PIN_DEBOUNCE_DISABLE|PIN_OUTPUT|PIN_DRIVE_STRENGTH_NOMINAL|PIN_SCMITT_TRIGGER_ENABLE, 7) /* (A17) MCAN0_TX.GPIO1_60 Pin not configured */
		>;
	};
	mygpio161_notconf_pins_default: mygpio161_notconf-default-pins {
		pinctrl-single,pins = <
			AM64X_IOPAD(0x0254, PIN_DEBOUNCE_DISABLE|PIN_OUTPUT|PIN_DRIVE_STRENGTH_NOMINAL|PIN_SCMITT_TRIGGER_ENABLE, 7) /* (B17) MCAN0_RX.GPIO1_61 Pin not configured */
		>;
	};
	mygpio162_notconf_pins_default: mygpio162_notconf-default-pins {
		pinctrl-single,pins = <
			AM64X_IOPAD(0x0258, PIN_DEBOUNCE_DISABLE|PIN_OUTPUT|PIN_DRIVE_STRENGTH_NOMINAL|PIN_SCMITT_TRIGGER_ENABLE, 7) /* (C17) MCAN1_TX.GPIO1_62 Pin not configured */
		>;
	};
	mygpio163_notconf_pins_default: mygpio163_notconf-default-pins {
		pinctrl-single,pins = <
			AM64X_IOPAD(0x025c, PIN_DEBOUNCE_DISABLE|PIN_OUTPUT|PIN_DRIVE_STRENGTH_NOMINAL|PIN_SCMITT_TRIGGER_ENABLE, 7) /* (D17) MCAN1_RX.GPIO1_63 Pin not configured */
		>;
	};
	mygpio164_notconf_pins_default: mygpio164_notconf-default-pins {
		pinctrl-single,pins = <
			AM64X_IOPAD(0x0260, PIN_DEBOUNCE_DISABLE|PIN_INPUT|PIN_DRIVE_STRENGTH_NOMINAL|PIN_SCMITT_TRIGGER_ENABLE, 7) /* (A18) I2C0_SCL.GPIO1_64 Pin not configured */
		>;
	};
	mygpio165_notconf_pins_default: mygpio165_notconf-default-pins {
		pinctrl-single,pins = <
			AM64X_IOPAD(0x0264, PIN_DEBOUNCE_DISABLE|PIN_INPUT|PIN_DRIVE_STRENGTH_NOMINAL|PIN_SCMITT_TRIGGER_ENABLE, 7) /* (B18) I2C0_SDA.GPIO1_65 Pin not configured */
		>;
	};
	mygpio166_notconf_pins_default: mygpio166_notconf-default-pins {
		pinctrl-single,pins = <
			AM64X_IOPAD(0x0268, PIN_DEBOUNCE_DISABLE|PIN_OUTPUT|PIN_DRIVE_STRENGTH_NOMINAL|PIN_SCMITT_TRIGGER_ENABLE, 7) /* (C18) I2C1_SCL.GPIO1_66 Pin not configured */
		>;
	};
	mygpio167_notconf_pins_default: mygpio167_notconf-default-pins {
		pinctrl-single,pins = <
			AM64X_IOPAD(0x026c, PIN_DEBOUNCE_DISABLE|PIN_OUTPUT|PIN_DRIVE_STRENGTH_NOMINAL|PIN_SCMITT_TRIGGER_ENABLE, 7) /* (B19) I2C1_SDA.GPIO1_67 Pin not configured */
		>;
	};
	mygpio168_notconf_pins_default: mygpio168_notconf-default-pins {
		pinctrl-single,pins = <
			AM64X_IOPAD(0x0270, PIN_DEBOUNCE_DISABLE|PIN_OUTPUT|PIN_DRIVE_STRENGTH_NOMINAL|PIN_SCMITT_TRIGGER_ENABLE, 7) /* (D18) ECAP0_IN_APWM_OUT.GPIO1_68 Pin not configured */
		>;
	};
	mygpio169_notconf_pins_default: mygpio169_notconf-default-pins {
		pinctrl-single,pins = <
			AM64X_IOPAD(0x0274, PIN_DEBOUNCE_DISABLE|PIN_OUTPUT|PIN_DRIVE_STRENGTH_NOMINAL|PIN_SCMITT_TRIGGER_ENABLE, 7) /* (A19) EXT_REFCLK1.GPIO1_69 Pin not configured */
		>;
	};
	mygpio170_notconf_pins_default: mygpio170_notconf-default-pins {
		pinctrl-single,pins = <
			AM64X_IOPAD(0x0278, PIN_DEBOUNCE_DISABLE|PIN_OUTPUT|PIN_DRIVE_STRENGTH_NOMINAL|PIN_SCMITT_TRIGGER_ENABLE, 7) /* (C19) EXTINTn.GPIO1_70 Pin not configured */
		>;
	};
	mygpio171_notconf_pins_default: mygpio171_notconf-default-pins {
		pinctrl-single,pins = <
			AM64X_IOPAD(0x027c, PIN_DEBOUNCE_DISABLE|PIN_OUTPUT|PIN_DRIVE_STRENGTH_NOMINAL|PIN_SCMITT_TRIGGER_ENABLE, 7) /* (K18) MMC1_DAT3.GPIO1_71 Pin not configured */
		>;
	};
	mygpio172_notconf_pins_default: mygpio172_notconf-default-pins {
		pinctrl-single,pins = <
			AM64X_IOPAD(0x0280, PIN_DEBOUNCE_DISABLE|PIN_OUTPUT|PIN_DRIVE_STRENGTH_NOMINAL|PIN_SCMITT_TRIGGER_ENABLE, 7) /* (K19) MMC1_DAT2.GPIO1_72 Pin not configured */
		>;
	};
	mygpio173_notconf_pins_default: mygpio173_notconf-default-pins {
		pinctrl-single,pins = <
			AM64X_IOPAD(0x0284, PIN_DEBOUNCE_DISABLE|PIN_OUTPUT|PIN_DRIVE_STRENGTH_NOMINAL|PIN_SCMITT_TRIGGER_ENABLE, 7) /* (L21) MMC1_DAT1.GPIO1_73 Pin not configured */
		>;
	};
	mygpio174_notconf_pins_default: mygpio174_notconf-default-pins {
		pinctrl-single,pins = <
			AM64X_IOPAD(0x0288, PIN_DEBOUNCE_DISABLE|PIN_OUTPUT|PIN_DRIVE_STRENGTH_NOMINAL|PIN_SCMITT_TRIGGER_ENABLE, 7) /* (K21) MMC1_DAT0.GPIO1_74 Pin not configured */
		>;
	};
	mygpio175_notconf_pins_default: mygpio175_notconf-default-pins {
		pinctrl-single,pins = <
			AM64X_IOPAD(0x028c, PIN_DEBOUNCE_DISABLE|PIN_OUTPUT|PIN_DRIVE_STRENGTH_NOMINAL|PIN_SCMITT_TRIGGER_ENABLE, 7) /* (L20) MMC1_CLK.GPIO1_75 Pin not configured */
		>;
	};
	mygpio176_notconf_pins_default: mygpio176_notconf-default-pins {
		pinctrl-single,pins = <
			AM64X_IOPAD(0x0294, PIN_DEBOUNCE_DISABLE|PIN_OUTPUT|PIN_DRIVE_STRENGTH_NOMINAL|PIN_SCMITT_TRIGGER_ENABLE, 7) /* (J19) MMC1_CMD.GPIO1_76 Pin not configured */
		>;
	};
	mygpio177_notconf_pins_default: mygpio177_notconf-default-pins {
		pinctrl-single,pins = <
			AM64X_IOPAD(0x0298, PIN_DEBOUNCE_DISABLE|PIN_OUTPUT|PIN_DRIVE_STRENGTH_NOMINAL|PIN_SCMITT_TRIGGER_ENABLE, 7) /* (D19) MMC1_SDCD.GPIO1_77 Pin not configured */
		>;
	};
	mygpio178_notconf_pins_default: mygpio178_notconf-default-pins {
		pinctrl-single,pins = <
			AM64X_IOPAD(0x029c, PIN_DEBOUNCE_DISABLE|PIN_OUTPUT|PIN_DRIVE_STRENGTH_NOMINAL|PIN_SCMITT_TRIGGER_ENABLE, 7) /* (C20) MMC1_SDWP.GPIO1_78 Pin not configured */
		>;
	};
	mygpio179_notconf_pins_default: mygpio179_notconf-default-pins {
		pinctrl-single,pins = <
			AM64X_IOPAD(0x02a8, PIN_DEBOUNCE_DISABLE|PIN_OUTPUT_PULLDOWN|PIN_DRIVE_STRENGTH_NOMINAL|PIN_SCMITT_TRIGGER_ENABLE, 7) /* (E19) USB0_DRVVBUS.GPIO1_79 Pin not configured */
		>;
	};
	mymmc11_notconf_pins_default: mymmc11_notconf-default-pins {
		pinctrl-single,pins = <
			AM64X_IOPAD(0x0290, PIN_DEBOUNCE_DISABLE|PIN_OUTPUT|PIN_DRIVE_STRENGTH_NOMINAL|PIN_SCMITT_TRIGGER_ENABLE, 0) /* (MMC1_CLKLB) MMC1_CLKLB Pin not configured */
		>;
	};
	mysystem0_notconf_pins_default: mysystem0_notconf-default-pins {
		pinctrl-single,pins = <
			AM64X_IOPAD(0x02a0, PIN_DEBOUNCE_DISABLE|PIN_INPUT_PULLUP|PIN_DRIVE_STRENGTH_NOMINAL|PIN_SCMITT_TRIGGER_ENABLE, 0) /* (E18) RESET_REQz Pin not configured */
			AM64X_IOPAD(0x02a4, PIN_DEBOUNCE_DISABLE|PIN_OUTPUT|PIN_DRIVE_STRENGTH_NOMINAL|PIN_SCMITT_TRIGGER_ENABLE, 0) /* (F16) RESETSTATz Pin not configured */
			AM64X_IOPAD(0x02ac, PIN_DEBOUNCE_DISABLE|PIN_OUTPUT|PIN_DRIVE_STRENGTH_NOMINAL|PIN_SCMITT_TRIGGER_ENABLE, 0) /* (E17) PORz_OUT Pin not configured */
		>;
	};
	myadc0_notconf_pins_default: myadc0_notconf-default-pins {
		pinctrl-single,pins = <
			AM64X_IOPAD(0x02b0, PIN_DEBOUNCE_DISABLE|PIN_OUTPUT|PIN_DRIVE_STRENGTH_NOMINAL|PIN_SCMITT_TRIGGER_DISABLE, 0) /* (G20) ADC0_AIN0 Pin not configured */
			AM64X_IOPAD(0x02b4, PIN_DEBOUNCE_DISABLE|PIN_OUTPUT|PIN_DRIVE_STRENGTH_NOMINAL|PIN_SCMITT_TRIGGER_DISABLE, 0) /* (F20) ADC0_AIN1 Pin not configured */
			AM64X_IOPAD(0x02b8, PIN_DEBOUNCE_DISABLE|PIN_OUTPUT|PIN_DRIVE_STRENGTH_NOMINAL|PIN_SCMITT_TRIGGER_DISABLE, 0) /* (E21) ADC0_AIN2 Pin not configured */
			AM64X_IOPAD(0x02bc, PIN_DEBOUNCE_DISABLE|PIN_OUTPUT|PIN_DRIVE_STRENGTH_NOMINAL|PIN_SCMITT_TRIGGER_DISABLE, 0) /* (D20) ADC0_AIN3 Pin not configured */
			AM64X_IOPAD(0x02c0, PIN_DEBOUNCE_DISABLE|PIN_OUTPUT|PIN_DRIVE_STRENGTH_NOMINAL|PIN_SCMITT_TRIGGER_DISABLE, 0) /* (G21) ADC0_AIN4 Pin not configured */
			AM64X_IOPAD(0x02c4, PIN_DEBOUNCE_DISABLE|PIN_OUTPUT|PIN_DRIVE_STRENGTH_NOMINAL|PIN_SCMITT_TRIGGER_DISABLE, 0) /* (F21) ADC0_AIN5 Pin not configured */
			AM64X_IOPAD(0x02c8, PIN_DEBOUNCE_DISABLE|PIN_OUTPUT|PIN_DRIVE_STRENGTH_NOMINAL|PIN_SCMITT_TRIGGER_DISABLE, 0) /* (F19) ADC0_AIN6 Pin not configured */
			AM64X_IOPAD(0x02cc, PIN_DEBOUNCE_DISABLE|PIN_OUTPUT|PIN_DRIVE_STRENGTH_NOMINAL|PIN_SCMITT_TRIGGER_DISABLE, 0) /* (E20) ADC0_AIN7 Pin not configured */
		>;
	};
};

&mcu_pmx0 {
	mymcu_gpio013_notconf_pins_default: mymcu_gpio013_notconf-default-pins {
		pinctrl-single,pins = <
			AM64X_MCU_IOPAD(0x0000, PIN_DEBOUNCE_DISABLE|PIN_OUTPUT|PIN_DRIVE_STRENGTH_NOMINAL|PIN_SCMITT_TRIGGER_ENABLE, 7) /* (D6) MCU_SPI0_CS0.MCU_GPIO0_13 Pin not configured */
		>;
	};
	mymcu_gpio012_notconf_pins_default: mymcu_gpio012_notconf-default-pins {
		pinctrl-single,pins = <
			AM64X_MCU_IOPAD(0x0004, PIN_DEBOUNCE_DISABLE|PIN_OUTPUT|PIN_DRIVE_STRENGTH_NOMINAL|PIN_SCMITT_TRIGGER_ENABLE, 7) /* (C6) MCU_SPI0_CS1.MCU_GPIO0_12 Pin not configured */
		>;
	};
	mymcu_gpio011_notconf_pins_default: mymcu_gpio011_notconf-default-pins {
		pinctrl-single,pins = <
			AM64X_MCU_IOPAD(0x0008, PIN_DEBOUNCE_DISABLE|PIN_OUTPUT|PIN_DRIVE_STRENGTH_NOMINAL|PIN_SCMITT_TRIGGER_ENABLE, 7) /* (E6) MCU_SPI0_CLK.MCU_GPIO0_11 Pin not configured */
		>;
	};
	mymcu_gpio010_notconf_pins_default: mymcu_gpio010_notconf-default-pins {
		pinctrl-single,pins = <
			AM64X_MCU_IOPAD(0x000c, PIN_DEBOUNCE_DISABLE|PIN_OUTPUT|PIN_DRIVE_STRENGTH_NOMINAL|PIN_SCMITT_TRIGGER_ENABLE, 7) /* (E7) MCU_SPI0_D0.MCU_GPIO0_10 Pin not configured */
		>;
	};
	mymcu_gpio04_notconf_pins_default: mymcu_gpio04_notconf-default-pins {
		pinctrl-single,pins = <
			AM64X_MCU_IOPAD(0x0010, PIN_DEBOUNCE_DISABLE|PIN_OUTPUT|PIN_DRIVE_STRENGTH_NOMINAL|PIN_SCMITT_TRIGGER_ENABLE, 7) /* (B6) MCU_SPI0_D1.MCU_GPIO0_4 Pin not configured */
		>;
	};
	mymcu_gpio05_notconf_pins_default: mymcu_gpio05_notconf-default-pins {
		pinctrl-single,pins = <
			AM64X_MCU_IOPAD(0x0014, PIN_DEBOUNCE_DISABLE|PIN_OUTPUT|PIN_DRIVE_STRENGTH_NOMINAL|PIN_SCMITT_TRIGGER_ENABLE, 7) /* (A7) MCU_SPI1_CS0.MCU_GPIO0_5 Pin not configured */
		>;
	};
	mymcu_gpio06_notconf_pins_default: mymcu_gpio06_notconf-default-pins {
		pinctrl-single,pins = <
			AM64X_MCU_IOPAD(0x0018, PIN_DEBOUNCE_DISABLE|PIN_OUTPUT|PIN_DRIVE_STRENGTH_NOMINAL|PIN_SCMITT_TRIGGER_ENABLE, 7) /* (B7) MCU_SPI1_CS1.MCU_GPIO0_6 Pin not configured */
		>;
	};
	mymcu_gpio07_notconf_pins_default: mymcu_gpio07_notconf-default-pins {
		pinctrl-single,pins = <
			AM64X_MCU_IOPAD(0x001c, PIN_DEBOUNCE_DISABLE|PIN_OUTPUT|PIN_DRIVE_STRENGTH_NOMINAL|PIN_SCMITT_TRIGGER_ENABLE, 7) /* (D7) MCU_SPI1_CLK.MCU_GPIO0_7 Pin not configured */
		>;
	};
	mymcu_gpio08_notconf_pins_default: mymcu_gpio08_notconf-default-pins {
		pinctrl-single,pins = <
			AM64X_MCU_IOPAD(0x0020, PIN_DEBOUNCE_DISABLE|PIN_OUTPUT|PIN_DRIVE_STRENGTH_NOMINAL|PIN_SCMITT_TRIGGER_ENABLE, 7) /* (C7) MCU_SPI1_D0.MCU_GPIO0_8 Pin not configured */
		>;
	};
	mymcu_gpio09_notconf_pins_default: mymcu_gpio09_notconf-default-pins {
		pinctrl-single,pins = <
			AM64X_MCU_IOPAD(0x0024, PIN_DEBOUNCE_DISABLE|PIN_OUTPUT|PIN_DRIVE_STRENGTH_NOMINAL|PIN_SCMITT_TRIGGER_ENABLE, 7) /* (C8) MCU_SPI1_D1.MCU_GPIO0_9 Pin not configured */
		>;
	};
	mymcu_gpio03_notconf_pins_default: mymcu_gpio03_notconf-default-pins {
		pinctrl-single,pins = <
			AM64X_MCU_IOPAD(0x0028, PIN_DEBOUNCE_DISABLE|PIN_OUTPUT|PIN_DRIVE_STRENGTH_NOMINAL|PIN_SCMITT_TRIGGER_ENABLE, 7) /* (A9) MCU_UART0_RXD.MCU_GPIO0_3 Pin not configured */
		>;
	};
	mymcu_gpio02_notconf_pins_default: mymcu_gpio02_notconf-default-pins {
		pinctrl-single,pins = <
			AM64X_MCU_IOPAD(0x002c, PIN_DEBOUNCE_DISABLE|PIN_OUTPUT|PIN_DRIVE_STRENGTH_NOMINAL|PIN_SCMITT_TRIGGER_ENABLE, 7) /* (A8) MCU_UART0_TXD.MCU_GPIO0_2 Pin not configured */
		>;
	};
	mymcu_gpio01_notconf_pins_default: mymcu_gpio01_notconf-default-pins {
		pinctrl-single,pins = <
			AM64X_MCU_IOPAD(0x0030, PIN_DEBOUNCE_DISABLE|PIN_OUTPUT|PIN_DRIVE_STRENGTH_NOMINAL|PIN_SCMITT_TRIGGER_ENABLE, 7) /* (D8) MCU_UART0_CTSn.MCU_GPIO0_1 Pin not configured */
		>;
	};
	mymcu_gpio00_notconf_pins_default: mymcu_gpio00_notconf-default-pins {
		pinctrl-single,pins = <
			AM64X_MCU_IOPAD(0x0034, PIN_DEBOUNCE_DISABLE|PIN_OUTPUT|PIN_DRIVE_STRENGTH_NOMINAL|PIN_SCMITT_TRIGGER_ENABLE, 7) /* (E8) MCU_UART0_RTSn.MCU_GPIO0_0 Pin not configured */
		>;
	};
	mymcu_gpio014_notconf_pins_default: mymcu_gpio014_notconf-default-pins {
		pinctrl-single,pins = <
			AM64X_MCU_IOPAD(0x0038, PIN_DEBOUNCE_DISABLE|PIN_OUTPUT|PIN_DRIVE_STRENGTH_NOMINAL|PIN_SCMITT_TRIGGER_ENABLE, 7) /* (C9) MCU_UART1_RXD.MCU_GPIO0_14 Pin not configured */
		>;
	};
	mymcu_gpio015_notconf_pins_default: mymcu_gpio015_notconf-default-pins {
		pinctrl-single,pins = <
			AM64X_MCU_IOPAD(0x003c, PIN_DEBOUNCE_DISABLE|PIN_OUTPUT|PIN_DRIVE_STRENGTH_NOMINAL|PIN_SCMITT_TRIGGER_ENABLE, 7) /* (D9) MCU_UART1_TXD.MCU_GPIO0_15 Pin not configured */
		>;
	};
	mymcu_gpio016_notconf_pins_default: mymcu_gpio016_notconf-default-pins {
		pinctrl-single,pins = <
			AM64X_MCU_IOPAD(0x0040, PIN_DEBOUNCE_DISABLE|PIN_OUTPUT|PIN_DRIVE_STRENGTH_NOMINAL|PIN_SCMITT_TRIGGER_ENABLE, 7) /* (B8) MCU_UART1_CTSn.MCU_GPIO0_16 Pin not configured */
		>;
	};
	mymcu_gpio017_notconf_pins_default: mymcu_gpio017_notconf-default-pins {
		pinctrl-single,pins = <
			AM64X_MCU_IOPAD(0x0044, PIN_DEBOUNCE_DISABLE|PIN_OUTPUT|PIN_DRIVE_STRENGTH_NOMINAL|PIN_SCMITT_TRIGGER_ENABLE, 7) /* (B9) MCU_UART1_RTSn.MCU_GPIO0_17 Pin not configured */
		>;
	};
	mymcu_gpio018_notconf_pins_default: mymcu_gpio018_notconf-default-pins {
		pinctrl-single,pins = <
			AM64X_MCU_IOPAD(0x0048, PIN_DEBOUNCE_DISABLE|PIN_INPUT|PIN_DRIVE_STRENGTH_NOMINAL|PIN_SCMITT_TRIGGER_ENABLE, 7) /* (E9) MCU_I2C0_SCL.MCU_GPIO0_18 Pin not configured */
		>;
	};
	mymcu_gpio019_notconf_pins_default: mymcu_gpio019_notconf-default-pins {
		pinctrl-single,pins = <
			AM64X_MCU_IOPAD(0x004c, PIN_DEBOUNCE_DISABLE|PIN_INPUT|PIN_DRIVE_STRENGTH_NOMINAL|PIN_SCMITT_TRIGGER_ENABLE, 7) /* (A10) MCU_I2C0_SDA.MCU_GPIO0_19 Pin not configured */
		>;
	};
	mymcu_gpio020_notconf_pins_default: mymcu_gpio020_notconf-default-pins {
		pinctrl-single,pins = <
			AM64X_MCU_IOPAD(0x0050, PIN_DEBOUNCE_DISABLE|PIN_OUTPUT|PIN_DRIVE_STRENGTH_NOMINAL|PIN_SCMITT_TRIGGER_ENABLE, 7) /* (A11) MCU_I2C1_SCL.MCU_GPIO0_20 Pin not configured */
		>;
	};
	mymcu_gpio021_notconf_pins_default: mymcu_gpio021_notconf-default-pins {
		pinctrl-single,pins = <
			AM64X_MCU_IOPAD(0x0054, PIN_DEBOUNCE_DISABLE|PIN_OUTPUT|PIN_DRIVE_STRENGTH_NOMINAL|PIN_SCMITT_TRIGGER_ENABLE, 7) /* (B10) MCU_I2C1_SDA.MCU_GPIO0_21 Pin not configured */
		>;
	};
	mymcu_system0_notconf_pins_default: mymcu_system0_notconf-default-pins {
		pinctrl-single,pins = <
			AM64X_MCU_IOPAD(0x0058, PIN_DEBOUNCE_DISABLE|PIN_INPUT_PULLUP|PIN_DRIVE_STRENGTH_NOMINAL|PIN_SCMITT_TRIGGER_ENABLE, 0) /* (B12) MCU_RESETz Pin not configured */
			AM64X_MCU_IOPAD(0x005c, PIN_DEBOUNCE_DISABLE|PIN_OUTPUT|PIN_DRIVE_STRENGTH_NOMINAL|PIN_SCMITT_TRIGGER_ENABLE, 0) /* (B21) MCU_PORz Pin not configured */
			AM64X_MCU_IOPAD(0x0060, PIN_DEBOUNCE_DISABLE|PIN_OUTPUT|PIN_DRIVE_STRENGTH_NOMINAL|PIN_SCMITT_TRIGGER_ENABLE, 0) /* (B13) MCU_RESETSTATz Pin not configured */
			AM64X_MCU_IOPAD(0x0064, PIN_DEBOUNCE_DISABLE|PIN_INPUT_PULLDOWN|PIN_DRIVE_STRENGTH_NOMINAL|PIN_SCMITT_TRIGGER_ENABLE, 0) /* (A20) MCU_SAFETY_ERRORn Pin not configured */
		>;
	};
	myjtag0_notconf_pins_default: myjtag0_notconf-default-pins {
		pinctrl-single,pins = <
			AM64X_MCU_IOPAD(0x0068, PIN_DEBOUNCE_DISABLE|PIN_INPUT_PULLUP|PIN_DRIVE_STRENGTH_NOMINAL|PIN_SCMITT_TRIGGER_ENABLE, 0) /* (B11) TCK Pin not configured */
			AM64X_MCU_IOPAD(0x006c, PIN_DEBOUNCE_DISABLE|PIN_INPUT_PULLDOWN|PIN_DRIVE_STRENGTH_NOMINAL|PIN_SCMITT_TRIGGER_ENABLE, 0) /* (D11) TRSTn Pin not configured */
			AM64X_MCU_IOPAD(0x0070, PIN_DEBOUNCE_DISABLE|PIN_INPUT_PULLUP|PIN_DRIVE_STRENGTH_NOMINAL|PIN_SCMITT_TRIGGER_ENABLE, 0) /* (C11) TDI Pin not configured */
			AM64X_MCU_IOPAD(0x0074, PIN_DEBOUNCE_DISABLE|PIN_OUTPUT_PULLUP|PIN_DRIVE_STRENGTH_NOMINAL|PIN_SCMITT_TRIGGER_ENABLE, 0) /* (A12) TDO Pin not configured */
			AM64X_MCU_IOPAD(0x0078, PIN_DEBOUNCE_DISABLE|PIN_INPUT_PULLUP|PIN_DRIVE_STRENGTH_NOMINAL|PIN_SCMITT_TRIGGER_ENABLE, 0) /* (C12) TMS Pin not configured */
			AM64X_MCU_IOPAD(0x007c, PIN_DEBOUNCE_DISABLE|PIN_INPUT_PULLUP|PIN_DRIVE_STRENGTH_NOMINAL|PIN_SCMITT_TRIGGER_ENABLE, 0) /* (D10) EMU0 Pin not configured */
			AM64X_MCU_IOPAD(0x0080, PIN_DEBOUNCE_DISABLE|PIN_INPUT_PULLUP|PIN_DRIVE_STRENGTH_NOMINAL|PIN_SCMITT_TRIGGER_ENABLE, 0) /* (E10) EMU1 Pin not configured */
		>;
	};
};
